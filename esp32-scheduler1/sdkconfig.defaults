## esp32-scheduler1/sdkconfig.defaults
```kconfig
CONFIG_FREERTOS_GENERATE_RUN_TIME_STATS=y
CONFIG_FREERTOS_USE_STATS_FORMATTING_FUNCTIONS=y
CONFIG_FREERTOS_TRACE_FACILITY=y
CONFIG_FREERTOS_UNICORE=y

# Prioritized Pre-emptive with Time Slicing
# CONFIG_FREERTOS_USE_PREEMPTION=y
# CONFIG_FREERTOS_TIME_SLICING=y


# Prioritized Pre-emptive without Time Slicing
# CONFIG_FREERTOS_USE_PREEMPTION=y
# CONFIG_FREERTOS_TIME_SLICING=n


# Co-operative
CONFIG_FREERTOS_USE_PREEMPTION=n
CONFIG_FREERTOS_TIME_SLICING=n
```
